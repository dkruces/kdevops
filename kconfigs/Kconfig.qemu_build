## kconfigs/Kconfig.qemu_build
```kconfig
# SPDX-License-Identifier: copyleft-next-0.3.1
#
# Backend-agnostic QEMU build knobs. Both libvirt (Kconfig.libvirt
# QEMU_BIN_PATH_LIBVIRT consumer) and qsu (Kconfig.qemu_system_units
# QEMU_SYSTEM_UNITS_QEMU_BINARY consumer) read the artefacts this
# fragment produces, so the symbols here must stay reachable
# regardless of the selected bringup backend. The fragment is
# sourced unconditionally from kconfigs/Kconfig.bringup.

config QEMU_BUILD
	bool "Should we build QEMU for you?"
	help
	  You only want to enable this option if your distribution package
	  of QEMU does not have support for the features you need. For
	  example this may be useful if you are a QEMU developer or are
	  relying on technology is still under development or if you have
	  a custom QEMU git URL.

	  The build runs entirely under KDEVOPS_CONTROLLER_DATA_PATH.
	  ninja install lands the artefacts in QEMU_BUILD_DESTDIR
	  without sudo and without polluting the host's /usr or
	  /usr/local prefixes. Both the libvirt and qsu bringup
	  paths consume the resulting binary via the synthetic
	  QEMU_BUILD_BIN_PATH symbol.

if !QEMU_BUILD

config QEMU_USE_DEVELOPMENT_VERSION
	bool "Should we look for a development version of QEMU?"
	help
	  You want to enable this option if for example the currently
	  available version of QEMU does not yet have support for the feature
	  you are going to be working on.

	  Say yes here if you are compiling your own version of QEMU.

endif # !QEMU_BUILD

if QEMU_BUILD

choice
	prompt "QEMU git URL to use"
	default QEMU_BUILD_JIC23

config QEMU_BUILD_UPSTREAM
	bool "https://gitlab.com/qemu-project/qemu.git"
	help
	  Select this option if you want to use the upstream QEMU git repo.

config QEMU_BUILD_JIC23
	bool "https://gitlab.com/jic23/qemu.git"
	help
	  Select this option if you want to use Cameron's QEMU git repo.
	  This has a few CXL bells and whistles which are not yet upstream.

config QEMU_BUILD_MANUAL
	bool "Custom QEMU git URL"
	help
	  Select this option if you want to specify your own git URL.

endchoice

config QEMU_BUILD_GIT
	string "Git tree for QEMU to clone on localhost"
	default "/mirror/qemu.git" if USE_LOCAL_LINUX_MIRROR && QEMU_BUILD_UPSTREAM || QEMU_BUILD_MANUAL
	default "/mirror/qemu-jic23.git" if USE_LOCAL_LINUX_MIRROR && QEMU_BUILD_JIC23
	default DEFAULT_QEMU_GITHUB_HTTPS_URL if !USE_LOCAL_LINUX_MIRROR && QEMU_BUILD_UPSTREAM || QEMU_BUILD_MANUAL
	default DEFAULT_QEMU_JIC23_GITHUB_HTTPS_URL if !USE_LOCAL_LINUX_MIRROR && QEMU_BUILD_JIC23
	help
	  This is the git URL to use to clone and then build QEMU for you on
	  your localhost.

# Deprecated alias for QEMU_BUILD_TREE_PATH. Promptable so an
# existing out-of-tree defconfig that still sets
# CONFIG_QEMU_BUILD_GIT_DATA_PATH continues to be honoured;
# QEMU_BUILD_TREE_PATH below picks the value up via its first
# default branch. The symbol stays in menuconfig as
# "(deprecated)" so users see the rename guidance. Drop in a
# follow-up cleanup once no defconfig still references the old
# name.
config QEMU_BUILD_GIT_DATA_PATH
	string "(deprecated) Use QEMU_BUILD_TREE_PATH instead"
	default ""
	help
	  Deprecated. Set QEMU_BUILD_TREE_PATH instead. Kept for
	  backward compatibility with defconfigs predating the
	  rename. When set non-empty, QEMU_BUILD_TREE_PATH defaults
	  to this value.

config QEMU_BUILD_TREE_PATH
	string "QEMU source tree path"
	output yaml
	default QEMU_BUILD_GIT_DATA_PATH if QEMU_BUILD_GIT_DATA_PATH != ""
	default "{{ kdevops_controller_data_path }}/qemu"
	help
	  Absolute path on the control node where the QEMU source
	  tree lives. Defaults to a qemu/ subdirectory of
	  KDEVOPS_CONTROLLER_DATA_PATH so it sits alongside the other
	  controller-side build artefacts (qemu-build/, qemu-destdir/),
	  mirroring the BOOTLINUX_CONTROLLER_TREE_PATH convention used
	  by the kernel build.

	  kdevops manages the tree only when this path is empty: the
	  initial bringup clones QEMU_BUILD_GIT at QEMU_BUILD_GIT_VERSION
	  into the path. If the path already contains a git checkout —
	  manually cloned, a git worktree (whose .git is a file
	  pointing at the parent's gitdir), a symlink to another
	  checkout, or a previous kdevops bringup — kdevops detects
	  it and skips clone, fetch, and checkout entirely. Subsequent
	  invocations build against whatever HEAD the tree happens to
	  be on. This is the supported way to point kdevops at your
	  own QEMU checkout (set this to your checkout path and
	  iterate against working-tree changes; ninja's source-level
	  dependency tracking handles incrementality).

config QEMU_BUILD_BUILDDIR
	string "Out-of-tree QEMU build directory"
	output yaml
	default "{{ kdevops_controller_data_path }}/qemu-build"
	help
	  Absolute path to the QEMU out-of-tree build directory.
	  Defaults to a sibling of the QEMU source tree under
	  KDEVOPS_CONTROLLER_DATA_PATH. configure runs with this
	  directory as cwd so meson lays its build artefacts here
	  rather than polluting the source tree, exactly the way
	  BOOTLINUX_CONTROLLER_BUILDDIR works for the kernel out-of-
	  tree build (passed as O= to make).

config QEMU_BUILD_DESTDIR
	string "QEMU install destdir"
	output yaml
	default "{{ kdevops_controller_data_path }}/qemu-destdir"
	help
	  Absolute path where ninja install places the built QEMU
	  binaries and supporting files. The build is configured with
	  --prefix=<this>, so ninja install populates a self-contained
	  tree at <destdir>/bin, <destdir>/share, <destdir>/lib without
	  touching /usr, /usr/local, or any system path, and without
	  requiring sudo. Consumers locate the binary at
	  <destdir>/bin/qemu-system-<arch>. Mirrors
	  BOOTLINUX_CONTROLLER_DESTDIR for the kernel install.

config QEMU_BUILD_BIN_PATH
	string
	output yaml
	default "{{ qemu_build_destdir }}/bin/qemu-system-x86_64" if TARGET_ARCH_X86_64
	default "{{ qemu_build_destdir }}/bin/qemu-system-aarch64" if TARGET_ARCH_ARM64
	default "{{ qemu_build_destdir }}/bin/qemu-system-ppc64" if TARGET_ARCH_PPC64LE
	help
	  Synthetic, derived. Absolute path to the QEMU binary that
	  the build_qemu role's ninja install step writes. Both the
	  libvirt path (gen-nodes Makefile, libvirt domain XML
	  emulator element) and the qsu path
	  (Kconfig.qemu_system_units QEMU_SYSTEM_UNITS_QEMU_BINARY
	  default) consume this when QEMU_BUILD=y. The value is a
	  Jinja2 template that resolves at Ansible-use time against
	  qemu_build_destdir, which itself resolves against
	  kdevops_controller_data_path.

config QEMU_BUILD_GIT_VERSION
	string "The version of QEMU to build"
	default "cxl-2023-05-19" if QEMU_BUILD_JIC23
	default "v8.0.0-rc1" if QEMU_BUILD_UPSTREAM
	help
	  This is the target build version of QEMU to build. Please use
	  at least v7.2.0 for CXL support. v8.0.0-rc1 has some build fixes
	  for newer compilers so it is the default now.

config QEMU_USE_DEVELOPMENT_VERSION
	bool
	default y

endif # QEMU_BUILD
```

## modules/monitoring/Kconfig
```kconfig
# SPDX-License-Identifier: copyleft-next-0.3.1

config ENABLE_MONITORING
	bool "Enable monitoring services during workflow execution"
	output yaml
	default n
	help
	  Enable monitoring services to collect statistics during workflow
	  execution. This allows collection of various system metrics while
	  workflows are running.

	  Monitoring services run in the background during test execution and
	  automatically collect results afterward. The collected data can be
	  used for performance analysis, debugging, and understanding system
	  behavior during tests.

	  Individual workflows must add support for monitoring integration.
	  Currently supported workflows:
	  - fstests

if ENABLE_MONITORING

config MONITOR_DEVELOPMENTAL_STATS
	bool "Enable developmental statistics (not yet upstream)"
	output yaml
	default n
	help
	  Enable collection of statistics that are still in development
	  and not yet merged upstream in the Linux kernel.

	  This is useful for testing and validating new kernel features
	  that provide additional debugging or performance metrics.

if MONITOR_DEVELOPMENTAL_STATS

source "modules/monitoring/monitors/folio_migration/Kconfig"
source "modules/monitoring/monitors/memory_fragmentation/Kconfig"

endif # MONITOR_DEVELOPMENTAL_STATS

source "modules/monitoring/monitors/nvme_ocp_smart/Kconfig"

endif # ENABLE_MONITORING
```

## modules/monitoring/monitors/folio_migration/Kconfig
```kconfig
# SPDX-License-Identifier: copyleft-next-0.3.1

config MONITOR_FOLIO_MIGRATION
	bool "Monitor folio migration statistics"
	output yaml
	default n
	help
	  Enable monitoring of folio migration statistics if available.
	  This requires the kernel to have the folio migration debugfs
	  stats patch applied.

	  The statistics are collected from:
	  /sys/kernel/debug/mm/migrate/stats

	  This feature collects migration statistics periodically during
	  workflow execution and can generate plots for visualization.

config MONITOR_FOLIO_MIGRATION_INTERVAL
	int "Folio migration monitoring interval (seconds)"
	output yaml
	default 60
	depends on MONITOR_FOLIO_MIGRATION
	help
	  How often to collect folio migration statistics in seconds.
	  Default is 60 seconds.

	  Lower values provide more granular data but may impact system
	  performance. Higher values reduce overhead but may miss
	  short-lived migration events.
```

## modules/monitoring/monitors/memory_fragmentation/Kconfig
```kconfig
# SPDX-License-Identifier: copyleft-next-0.3.1

config MONITOR_MEMORY_FRAGMENTATION
	bool "Monitor memory fragmentation with eBPF"
	output yaml
	default n
	help
	  Enable monitoring of memory fragmentation using eBPF-based tracking.
	  This provides advanced memory fragmentation visualization using
	  eBPF tracepoints and matplotlib.

	  This tool tracks memory allocation events and fragmentation indices
	  in real-time, providing insights that traditional methods like
	  /proc/pagetypeinfo cannot fully capture.

	  Features:
	  - eBPF-based tracepoint tracking
	  - Real-time fragmentation index monitoring
	  - Page mobility tracking
	  - Matplotlib visualization of fragmentation data

	  Requirements:
	  - Python 3 with python3-bpfcc
	  - Kernel with required tracepoint support
	  - Root privileges for eBPF attachment

	  The tool is particularly useful for investigating whether Large Block
	  Size support in the kernel creates worse fragmentation.

config MONITOR_MEMORY_FRAGMENTATION_DURATION
	int "Memory fragmentation monitoring duration (seconds)"
	output yaml
	default 0
	depends on MONITOR_MEMORY_FRAGMENTATION
	help
	  Duration to run fragmentation monitoring in seconds.
	  Set to 0 for continuous monitoring until workflow completion.

	  The monitoring will automatically stop when the workflow
	  finishes or when this duration expires, whichever comes first.

config MONITOR_MEMORY_FRAGMENTATION_OUTPUT_DIR
	string "Memory fragmentation monitoring output directory"
	output yaml
	default "/root/monitoring/fragmentation"
	depends on MONITOR_MEMORY_FRAGMENTATION
	help
	  Directory where fragmentation monitoring data and plots will be stored.
	  This directory will be created if it doesn't exist.

	  The collected data includes:
	  - Raw eBPF trace data
	  - Generated matplotlib plots
	  - JSON formatted fragmentation metrics
```

## modules/monitoring/monitors/nvme_ocp_smart/Kconfig
```kconfig
# SPDX-License-Identifier: copyleft-next-0.3.1

config MONITOR_NVME_OCP_SMART
	bool "Monitor NVMe OCP extended SMART statistics"
	output yaml
	default n
	help
	  Enable monitoring of NVMe OCP (Open Compute Project) extended SMART
	  statistics using nvme-cli OCP plugin.

	  Collects extended statistics from:
	  nvme ocp smart-add-log --output-format=json

	  The collected data includes cloud SSD specific metrics:
	  - Advanced wear leveling data (erase counts, bad blocks)
	  - Extended reliability metrics (ECC errors, XOR recovery)
	  - Thermal throttling and power management data
	  - Capacitor health and power loss protection status
	  - PCIe error counters and endurance estimates

config MONITOR_NVME_OCP_SMART_INTERVAL
	int "NVMe OCP SMART monitoring interval (seconds)"
	output yaml
	default 120
	depends on MONITOR_NVME_OCP_SMART
	range 60 3600
	help
	  How often to collect NVMe OCP SMART statistics in seconds.
	  Default is 120 seconds (2 minutes).

	  OCP SMART data changes more slowly than standard SMART metrics,
	  so longer intervals are appropriate. Shorter intervals may not
	  provide meaningful additional data and increase system overhead.

config MONITOR_NVME_OCP_SMART_DEVICES
	string "NVMe OCP devices to monitor (space-separated)"
	output yaml
	default "auto"
	depends on MONITOR_NVME_OCP_SMART
	help
	  Space-separated list of OCP-compatible NVMe devices to monitor.

	  Use "auto" to automatically discover OCP-compatible devices by
	  testing nvme ocp smart-add-log capability.

	  Manual specification: "/dev/nvme0n1 /dev/nvme1n1"
```
