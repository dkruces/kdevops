## kconfigs/Kconfig.guestfs
```kconfig
if GUESTFS

config GUESTFS_STORAGE_DIR
	string
	output yaml
	default "{{ kdevops_storage_pool_path }}/guestfs"

config GUESTFS_BASE_IMAGE_DIR
	string
	output yaml
	default "{{ guestfs_storage_dir }}/base_images"

config GUESTFS_HAS_CUSTOM_RAW_IMAGE
	bool
	output yaml

config GUESTFS_HAS_CUSTOM_RAW_IMAGE_URL
	bool
	output yaml

config GUESTFS_REQUIRES_UEFI
	bool
	output yaml

config GUESTFS_LACKS_9P
	bool

config GUESTFS_CUSTOM_RAW_IMAGE_URL
	depends on GUESTFS_HAS_CUSTOM_RAW_IMAGE
	depends on GUESTFS_HAS_CUSTOM_RAW_IMAGE_URL
	string
	output yaml
	default "https://cloud.debian.org/images/cloud/trixie/daily/latest/debian-13-generic-amd64-daily.raw" if GUESTFS_DEBIAN_TRIXIE_GENERIC_AMD64 && TARGET_ARCH_X86_64
	default "https://cloud.debian.org/images/cloud/trixie/daily/latest/debian-13-generic-arm64-daily.raw" if GUESTFS_DEBIAN_TRIXIE_GENERIC_AMD64 && TARGET_ARCH_ARM64
	default "https://cloud.debian.org/images/cloud/trixie/daily/latest/debian-13-genericcloud-amd64-daily.raw" if GUESTFS_DEBIAN_TRIXIE_GENERIC_CLOUD_AMD64 && TARGET_ARCH_X86_64
	default "https://cloud.debian.org/images/cloud/trixie/daily/latest/debian-13-genericcloud-arm64-daily.raw" if GUESTFS_DEBIAN_TRIXIE_GENERIC_CLOUD_AMD64 && TARGET_ARCH_ARM64
	default "https://cloud.debian.org/images/cloud/trixie/daily/latest/debian-13-nocloud-amd64-daily.raw" if GUESTFS_DEBIAN_TRIXIE_NOCLOUD_AMD64 && TARGET_ARCH_X86_64
	default "https://cloud.debian.org/images/cloud/trixie/daily/latest/debian-13-nocloud-arm64-daily.raw" if GUESTFS_DEBIAN_TRIXIE_NOCLOUD_AMD64 && TARGET_ARCH_ARM64

config GUESTFS_HAS_CUSTOM_RAW_IMAGE_SHA512SUMS
	bool
	output yaml

config GUESTFS_CUSTOM_RAW_IMAGE_SHA512SUMS_URL
	string
	depends on GUESTFS_HAS_CUSTOM_RAW_IMAGE_SHA512SUMS
	output yaml
	default "https://cloud.debian.org/images/cloud/trixie/daily/latest/SHA512SUMS" if GUESTFS_DEBIAN_TRIXIE

config GUESTFS_HAS_CUSTOM_RAW_IMAGE_ROLLING
	bool
	output yaml

config GUESTFS_HAS_DISTRO_SOURCE_COPY_CAPABILITIES
	bool

if GUESTFS_HAS_DISTRO_SOURCE_COPY_CAPABILITIES

config GUESTFS_COPY_SOURCES_FROM_HOST_TO_GUEST
	bool
	output yaml

config GUESTFS_DISTRO_SOURCE_AND_DEST_FILE
	string
	depends on GUESTFS_COPY_SOURCES_FROM_HOST_TO_GUEST
	output yaml
	default "/etc/apt/sources.list" if GUESTFS_DEBIAN

endif

choice
	prompt "Guestfs Linux distribution to use"
	default GUESTFS_FEDORA if DISTRO_FEDORA || DISTRO_REDHAT
	default GUESTFS_FEDORA if DISTRO_OPENSUSE || DISTRO_SUSE
	default GUESTFS_DEBIAN if DISTRO_DEBIAN || DISTRO_UBUNTU

config GUESTFS_FEDORA
	bool "Fedora (or derived distro)"
	select HAVE_DISTRO_XFS_PREFERS_MANUAL if FSTESTS_XFS
	select HAVE_DISTRO_BTRFS_PREFERS_MANUAL if FSTESTS_BTRFS
	select HAVE_DISTRO_EXT4_PREFERS_MANUAL if FSTESTS_EXT4
	select HAVE_DISTRO_PREFERS_FSTESTS_WATCHDOG if KDEVOPS_WORKFLOW_ENABLE_FSTESTS
	select HAVE_DISTRO_PREFERS_FSTESTS_WATCHDOG_KILL if KDEVOPS_WORKFLOW_ENABLE_FSTESTS
	help
	  This option will set the target guest to be a distro in the Fedora family.
	  For example, Fedora, RHEL, etc.

config GUESTFS_DEBIAN
	bool "Debian"
	select HAVE_CUSTOM_DISTRO_HOST_PREFIX
	select HAVE_DISTRO_XFS_PREFERS_MANUAL if FSTESTS_XFS
	select HAVE_DISTRO_BTRFS_PREFERS_MANUAL if FSTESTS_BTRFS
	select HAVE_DISTRO_EXT4_PREFERS_MANUAL if FSTESTS_EXT4
	select HAVE_DISTRO_PREFERS_CUSTOM_HOST_PREFIX
	select HAVE_DISTRO_PREFERS_FSTESTS_WATCHDOG if KDEVOPS_WORKFLOW_ENABLE_FSTESTS
	select HAVE_DISTRO_PREFERS_FSTESTS_WATCHDOG_KILL if KDEVOPS_WORKFLOW_ENABLE_FSTESTS
	select GUESTFS_HAS_DISTRO_SOURCE_COPY_CAPABILITIES
	help
	  This option will set the target guest to Debian.

endchoice

if GUESTFS_DEBIAN

choice
	prompt "Debian version"
	default GUESTFS_DEBIAN_TRIXIE

config GUESTFS_DEBIAN_TRIXIE
	bool "Debian 13 - Trixie"
	select GUESTFS_REQUIRES_UEFI
	select GUESTFS_HAS_CUSTOM_RAW_IMAGE
	select GUESTFS_HAS_CUSTOM_RAW_IMAGE_URL
	select GUESTFS_HAS_CUSTOM_RAW_IMAGE_SHA512SUMS
	select GUESTFS_HAS_CUSTOM_RAW_IMAGE_ROLLING
	help
	  Select this for debian trixie, debian 13. Since debian does not yet
	  provie a virt-builder repo, we must download mock up our own URL
	  for trixie release, as the default guestfs repo only has debian buster.
	  We download the image for you once, and once its there we don't refresh
	  it. We can later add support to force a refresh using the latest URL,
	  as trixie is debian-testing and debian testing always has an new
	  up to date image release, that is, its a rolling distribution release.

	  This doesn't work yet.. it gets stuck on the grub prompt.

config GUESTFS_DEBIAN_BUSTER
	bool "Debian 12 - Buster"
	help
	  Select this for debian buster, debian 12.

endchoice

if GUESTFS_DEBIAN_TRIXIE

choice
	prompt "Debian trixie flavor"
	default GUESTFS_DEBIAN_TRIXIE_GENERIC_AMD64

config GUESTFS_DEBIAN_TRIXIE_GENERIC_AMD64
	bool "debian-13-generic-amd64-daily"
	help
	  Should run in any environment using cloud-init, for e.g. OpenStack,
	  DigitalOcean and also on bare metal. This is the image you should
	  try to use and stick to for kernel testing.

config GUESTFS_DEBIAN_TRIXIE_GENERIC_CLOUD_AMD64
	bool "debian-13-genericcloud-amd64-daily"
	help
	  Similar to generic. Should run in any virtualised environment. Is
	  smaller than generic by excluding drivers for physical hardware.
	  Note that the 9p client filesystem module will not be available to
	  you with this image and so you cannot leverage 9p for building
	  Linux on the host. This image also requires a EFI boot loader
	  and secure boot is enabled by default which means your custom
	  kernels will need to be signed and this plumbing is not supported
	  yet so you are on your own.

config GUESTFS_DEBIAN_TRIXIE_NOCLOUD_AMD64
	bool "debian-13-nocloud-amd64-daily"
	help
	  Mostly useful for testing the build process itself. Doesn't have
	  cloud-init installed, but instead allows root login without a
	  password.

endchoice

endif # GUESTFS_DEBIAN_TRIXIE

config GUESTFS_DEBIAN_HOST_UPDATES_GUEST
	bool
	default y if GUESTFS_DEBIAN_BUSTER && DISTRO_DEBIAN_TRIXIE
	select KDEVOPS_TRY_REFRESH_REPOS
	select KDEVOPS_TRY_UPDATE_SYSTEMS

config GUESTFS_DEBIAN_HOST_GUEST_MATCH
	bool
	default y if GUESTFS_DEBIAN_BUSTER && DISTRO_DEBIAN_BUSTER
	default y if GUESTFS_DEBIAN_TRIXIE && DISTRO_DEBIAN_TRIXIE

config GUESTFS_DEBIAN_IMAGE_NAME
	string
	default "debian-13-generic-amd64-daily" if GUESTFS_DEBIAN_TRIXIE_GENERIC_AMD64 && TARGET_ARCH_X86_64
	default "debian-13-generic-arm64-daily" if GUESTFS_DEBIAN_TRIXIE_GENERIC_AMD64 && TARGET_ARCH_ARM64
	default "debian-13-genericcloud-amd64-daily" if GUESTFS_DEBIAN_TRIXIE_GENERIC_CLOUD_AMD64 && TARGET_ARCH_X86_64
	default "debian-13-genericcloud-arm64-daily" if GUESTFS_DEBIAN_TRIXIE_GENERIC_CLOUD_AMD64 && TARGET_ARCH_ARM64
	default "debian-13-nocloud-amd64-daily" if GUESTFS_DEBIAN_TRIXIE_NOCLOUD_AMD64 && TARGET_ARCH_X86_64
	default "debian-13-nocloud-arm64-daily" if GUESTFS_DEBIAN_TRIXIE_NOCLOUD_AMD64 && TARGET_ARCH_ARM64
	default "debian-12" if GUESTFS_DEBIAN_BUSTER

config GUESTFS_DEBIAN_BOX_SHORT
        string
        default "debian13" if GUESTFS_DEBIAN_TRIXIE
        default "debian12" if GUESTFS_DEBIAN_BUSTER

config GUESTFS_DEBIAN_COPY_HOST_SOURCES
	bool
	depends on GUESTFS_DEBIAN_HOST_GUEST_MATCH || GUESTFS_DEBIAN_HOST_UPDATES_GUEST
	default DISTRO_DEBIAN_HAS_HOP1_SOURCES
	select GUESTFS_COPY_SOURCES_FROM_HOST_TO_GUEST
	help
	  We have detected that you are running debian on the host, this option
	  will be enabled by default if we detect that your /etc/apt/sources.list
	  is using a source we determine has only one hop via traceroute to it,
	  for details of that heuristic see the script:

	    ./scripts/get-distro-has-hop-count-sources.sh

	  If your hop distance to your mirror is just 1, you are using debian on
	  the host, want to use debian guests, both host and guest match the
	  target release, then its a good assumtion you'd likely want to take
	  advantage of that same mirror for your guests. So disable this if you
	  really don't want to take advantage of your sources.list.

	  If this is disabled but you are sure you can use your host's
	  /etc/apt/sources.list on the guests then enable this.

endif # GUESTFS_DEBIAN

config VIRT_BUILDER_OS_VERSION
       string "virt-builder os-version"
       default "fedora-39" if GUESTFS_FEDORA
       default GUESTFS_DEBIAN_IMAGE_NAME if GUESTFS_DEBIAN
       help
         Have virt-builder use this os-version string to
         build a root image for the guest. Run "virt-builder -l"
         to get a list of operating systems and versions supported
         by guestfs.

choice
	prompt "Guestfs bringup debug mode"
	default GUESTFS_BRINGUP_DEBUG_DISABLED

config GUESTFS_BRINGUP_DEBUG_DISABLED
	bool "Disabled"
	help
	  Disables bringup debug.

config GUESTFS_BRINGUP_DEBUG_0
	bool "set -x"
	help
	  Enables 'set -x' when running scripts/guestfs_bringup.sh.

config GUESTFS_BRINGUP_DEBUG_1
	bool "set -euxo pipefile"
	help
	  Enables 'set -euxo pipefile' when running scripts/guestfs_bringup.sh.

endchoice

choice
	prompt "Guestfs destroy mode"
	default GUESTFS_DESTROY_TARGETED
	help
	  Configure the level of destruction when running 'make destroy'.
	  Different modes provide varying levels of cleanup from targeted
	  host destruction to comprehensive system purge.

config GUESTFS_DESTROY_TARGETED
	bool "Targeted cleanup (hosts file)"
	help
	  Default destroy mode that only removes VMs, volumes, and networks
	  defined in the current hosts file. This is the safest option and
	  preserves any manually created VMs or storage outside of kdevops.

	  This mode:
	  - Only destroys VMs listed in the current hosts file
	  - Removes associated storage volumes and networks
	  - Preserves manually created libvirt resources
	  - Maintains backward compatibility with existing behavior

config GUESTFS_DESTROY_PATTERN_BASED
	bool "Pattern-based cleanup"
	help
	  Destroys VMs, storage pools, and networks matching configurable
	  patterns. By default matches kdevops-style naming conventions
	  but can be customized for specific environments.

	  This mode:
	  - Uses regex patterns to identify resources to destroy
	  - Allows customization of VM, pool, and network patterns
	  - Provides more flexibility than targeted mode
	  - Still preserves resources that don't match patterns

config GUESTFS_DESTROY_COMPREHENSIVE
	bool "Complete cleanup"
	help
	  WARNING: This mode destroys ALL VMs, storage pools, and networks
	  except those explicitly preserved. Use with extreme caution.

	  This mode:
	  - Destroys all VMs except 'default'
	  - Removes all storage pools except 'default' and preserved patterns
	  - Cleans up all networks except 'default' and 'virbr0'
	  - Removes orphaned storage directories
	  - Cleans up kdevops artifacts and logs

	  This provides the most thorough cleanup possible.

endchoice

if GUESTFS_DESTROY_PATTERN_BASED

config GUESTFS_DESTROY_VM_PATTERN
	string "VM destruction pattern (regex)"
	output yaml
	default ".*[Kk][Dd][Ee][Vv][Oo][Pp][Ss].*|.*demo.*"
	help
	  Regular expression pattern for matching VMs to destroy in pattern-based
	  mode. The default pattern matches VMs with 'kdevops' or 'demo' in the name
	  (case insensitive).

	  Examples:
	  - ".*test.*" - matches VMs with 'test' in the name
	  - "^vm-.*" - matches VMs starting with 'vm-'
	  - ".*" - matches all VMs (use with caution)

config GUESTFS_DESTROY_POOL_PATTERN
	string "Storage pool destruction pattern (regex)"
	output yaml
	default ".*[Kk][Dd][Ee][Vv][Oo][Pp][Ss].*|.*demo.*|.*vm.*|.*guest.*|.*temp.*"
	help
	  Regular expression pattern for matching storage pools to destroy.
	  The default pattern matches pools with common development/testing names.

config GUESTFS_DESTROY_NETWORK_PATTERN
	string "Network destruction pattern (regex)"
	output yaml
	default ".*[Kk][Dd][Ee][Vv][Oo][Pp][Ss].*|.*demo.*|.*vm.*|.*guest.*|.*temp.*"
	help
	  Regular expression pattern for matching networks to destroy.
	  The default pattern matches networks with common development/testing names.

endif

if GUESTFS_DESTROY_COMPREHENSIVE

config GUESTFS_PRESERVE_POOL_PATTERN
	string "Storage pools to preserve (regex)"
	output yaml
	default "(home|users|data|backup|important)"
	help
	  Regular expression pattern for storage pools to preserve even in
	  comprehensive mode. These pools will never be destroyed regardless
	  of other settings.

	  The default preserves pools that typically contain user data.

endif

config GUESTFS_DEBUG_DESTROY
	bool "Enable destroy debug output"
	output yaml
	default n
	help
	  Enable verbose debug output during destroy operations. This will
	  show detailed information about what resources are being destroyed
	  and any errors encountered.

	  Useful for troubleshooting destroy operations or understanding
	  what resources would be affected before running the actual destroy.

config GUESTFS_PURGE_COMPREHENSIVE
	bool
	output yaml
	default y if GUESTFS_DESTROY_COMPREHENSIVE
	default n
	help
	  Internal variable that enables comprehensive purge mode when
	  comprehensive destroy is selected.


endif # GUESTFS
```
