## kconfigs/monitors/Kconfig
```kconfig
# SPDX-License-Identifier: copyleft-next-0.3.1

config ENABLE_MONITORING
	bool "Enable monitoring services during workflow execution"
	output yaml
	default n
	help
	  Enable monitoring services to collect statistics during workflow
	  execution. This allows collection of various system metrics while
	  workflows are running.

	  Monitoring services run in the background during test execution and
	  automatically collect results afterward. The collected data can be
	  used for performance analysis, debugging, and understanding system
	  behavior during tests.

	  Individual workflows must add support for monitoring integration.
	  Currently supported workflows:
	  - fstests

if ENABLE_MONITORING

config MONITOR_DEVELOPMENTAL_STATS
	bool "Enable developmental statistics (not yet upstream)"
	output yaml
	default n
	help
	  Enable collection of statistics that are still in development
	  and not yet merged upstream in the Linux kernel.

	  This is useful for testing and validating new kernel features
	  that provide additional debugging or performance metrics.

if MONITOR_DEVELOPMENTAL_STATS

config MONITOR_FOLIO_MIGRATION
	bool "Monitor folio migration statistics"
	output yaml
	default n
	help
	  Enable monitoring of folio migration statistics if available.
	  This requires the kernel to have the folio migration debugfs
	  stats patch applied.

	  The statistics are collected from:
	  /sys/kernel/debug/mm/migrate/stats

	  This feature collects migration statistics periodically during
	  workflow execution and can generate plots for visualization.

config MONITOR_FOLIO_MIGRATION_INTERVAL
	int "Folio migration monitoring interval (seconds)"
	output yaml
	default 60
	depends on MONITOR_FOLIO_MIGRATION
	help
	  How often to collect folio migration statistics in seconds.
	  Default is 60 seconds.

	  Lower values provide more granular data but may impact system
	  performance. Higher values reduce overhead but may miss
	  short-lived migration events.

endif # MONITOR_DEVELOPMENTAL_STATS

config MONITOR_NVME_SMART_LOG
	bool "Monitor NVMe SMART Log statistics"
	output yaml
	default n
	help
	  Enable monitoring of NVMe SMART Log statistics using standard nvme-cli
	  tools.

	  Requires:
	  - nvme-cli tools installed (nvme command available)
	  - NVMe devices supporting SMART log queries
	  - Root privileges for nvme command execution

	  Collects statistics from: nvme smart-log --output-format=json

	  The collected data includes:
	  - Device health: temperature, available spare, percentage used
	  - Performance: data units read/written, host commands
	  - Reliability: media errors, power cycles, unsafe shutdowns
	  - Thermal management: temperature warning and critical times

config MONITOR_NVME_SMART_LOG_INTERVAL
	int "NVMe SMART Log monitoring interval (seconds)"
	output yaml
	default 60
	depends on MONITOR_NVME_SMART_LOG
	range 20 3600
	help
	  How often to collect NVMe SMART Log statistics in seconds.
	  Default is 60 seconds (1 minute).

	  Lower values provide more granular data but may impact system
	  performance. Higher values reduce overhead but may miss
	  short-lived device behavior changes.

config MONITOR_NVME_SMART_LOG_DEVICES
	string "NVMe devices to monitor (space-separated)"
	output yaml
	default "auto"
	depends on MONITOR_NVME_SMART_LOG
	help
	  Space-separated list of NVMe devices to monitor (e.g., "/dev/nvme0n1 /dev/nvme1n1").

	  Use "auto" to automatically discover all available NVMe devices.

config MONITOR_NVME_OCP_SMART
	bool "Monitor NVMe OCP extended SMART statistics"
	output yaml
	default n
	help
	  Enable monitoring of NVMe OCP (Open Compute Project) extended SMART
	  statistics using nvme-cli OCP plugin.

	  Requires:
	  - nvme-cli tools with OCP plugin support
	  - OCP-compatible NVMe devices (cloud SSDs)
	  - Root privileges for nvme command execution

	  Collects extended statistics from: nvme ocp smart-add-log --output-format=json

	  The collected data includes cloud SSD specific metrics:
	  - Advanced wear leveling data (erase counts, bad blocks)
	  - Extended reliability metrics (ECC errors, XOR recovery)
	  - Thermal throttling and power management data
	  - Capacitor health and power loss protection status
	  - PCIe error counters and endurance estimates

	  This provides much more detailed telemetry than standard SMART logs
	  but only works with OCP-compatible cloud SSD hardware.

config MONITOR_NVME_OCP_SMART_INTERVAL
	int "NVMe OCP SMART monitoring interval (seconds)"
	output yaml
	default 120
	depends on MONITOR_NVME_OCP_SMART
	range 60 3600
	help
	  How often to collect NVMe OCP SMART statistics in seconds.
	  Default is 120 seconds (2 minutes).

	  OCP SMART data changes more slowly than standard SMART metrics,
	  so longer intervals are appropriate. Shorter intervals may not
	  provide meaningful additional data and increase system overhead.

config MONITOR_NVME_OCP_SMART_DEVICES
	string "NVMe OCP devices to monitor (space-separated)"
	output yaml
	default "auto"
	depends on MONITOR_NVME_OCP_SMART
	help
	  Space-separated list of OCP-compatible NVMe devices to monitor.

	  Use "auto" to automatically discover OCP-compatible devices by
	  testing nvme ocp smart-add-log capability.

	  Manual specification: "/dev/nvme0n1 /dev/nvme1n1"

# Future monitoring options can be added here
# Examples:
# - Memory pressure monitoring
# - CPU utilization tracking
# - I/O statistics collection
# - Network traffic monitoring
# - Custom perf event monitoring

endif # ENABLE_MONITORING
```

## kconfigs/workflows/Kconfig.bootlinux
```kconfig
# SPDX-License-Identifier: copyleft-next-0.3.1

config HAVE_BOOTLINUX_TREE_LINUS_GITREF
	bool
	default $(shell, scripts/check_file_empty.sh workflows/linux/Kconfig.refs-linus-gitref)

config HAVE_BOOTLINUX_TREE_NEXT_GITREF
	bool
	default $(shell, scripts/check_file_empty.sh workflows/linux/Kconfig.refs-next-gitref)

config HAVE_BOOTLINUX_TREE_STABLE_GITREF
	bool
	default $(shell, scripts/check_file_empty.sh workflows/linux/Kconfig.refs-stable-gitref)

config HAVE_BOOTLINUX_TREE_MCGROF_LINUS_GITREF
	bool
	default $(shell, scripts/check_file_empty.sh workflows/linux/Kconfig.refs-mcgrof-linus-gitref)

config HAVE_BOOTLINUX_TREE_MCGROF_NEXT_GITREF
	bool
	default $(shell, scripts/check_file_empty.sh workflows/linux/Kconfig.refs-mcgrof-next-gitref)

config HAVE_BOOTLINUX_TREE_BTRFS_DEVEL_GITREF
	bool
	default $(shell, scripts/check_file_empty.sh workflows/linux/Kconfig.refs-btrfs-devel-gitref)

config HAVE_BOOTLINUX_TREE_CEL_LINUX_GITREF
	bool
	default $(shell, scripts/check_file_empty.sh workflows/linux/Kconfig.refs-cel-linux-gitref)

config HAVE_BOOTLINUX_TREE_JLAYTON_LINUX_GITREF
	bool
	default $(shell, scripts/check_file_empty.sh workflows/linux/Kconfig.refs-jlayton-linux-gitref)

config HAVE_BOOTLINUX_TREE_KDEVOPS_LINUS_GITREF
	bool
	default $(shell, scripts/check_file_empty.sh workflows/linux/Kconfig.refs-kdevops-linus-gitref)
```

## runconf/Kconfig
```kconfig
config KDEVOPS_RUNCONF
	bool "runconf?"
	default n
	help
	  Hello runconf!

menu "Misc Playbook"
source "./runconf/misc-playbook/Kconfig"
endmenu
```

## workflows/fsbenchmarks/Kconfig
```kconfig
if KDEVOPS_WORKFLOW_ENABLE_FSBENCHMARKS

config FSBENCHMARKS_TMPFS_ENABLE
	bool

choice
	prompt "Target filesystem to benchmark"

config FSBENCHMARKS_TMPFS
	bool "tmpfs"
	select FSBENCHMARKS_TMPFS_ENABLE
	help
	  This will target tmpfs benchmarks.

endchoice

config FBENCHMARKS_FSTYP
	string
	default "tmpfs" if FSBENCHMARKS_TMPFS
	help
	  The filesystem to test. This will be automatically set depending on
	  the above choice, you however can override this manually.

if FSBENCHMARKS_TMPFS

menu "Configure how tmpfs should be tested"
source "workflows/fsbenchmarks/tmpfs/Kconfig"
endmenu

endif # FSBENCHMARKS_TMPFS

endif # KDEVOPS_WORKFLOW_ENABLE_FSBENCHMARKS
```

## workflows/fsbenchmarks/tmpfs/Kconfig
```kconfig
# SPDX-License-Identifier: copyleft-next-0.3.1

choice
	prompt "Test to run"

config FSBENCHMARKS_TMPFS_TEST00
	bool "Test 00 (fio)"
	help
	  Test00 loops over different tmpfs mount types and runs fio
	  for different block sizes (4k - 2M) using the configured
	  parameters. Here an example for the default mount profile:

	  mount -t tmpfs -o size=$MOUNTSIZE tmpfs /mnt/tmpfs

	  fio \
	      -name=test00 \
	      --nrfiles=$NRFILES -bs=$BS -direct=1 \
	      -ioengine=io_uring \
	      --group_reporting=1 \
	      --filesize=$FILESIZE \
	      --readwrite=write --fallocate=none \
	      --numjobs=$NUMJOBS --create_on_open=1 \
	      --directory=/mnt/tmpfs

	  Example: NRFILES=4; NUMJOBS=128; FILESIZE=1G will require
	  a mount size of 512G.

endchoice

if FSBENCHMARKS_TMPFS_TEST00

menu "Configure test00"

config FSBENCHMARKS_TMPFS_TEST00_NRFILES
	int "nrfiles"
	default 4

config FSBENCHMARKS_TMPFS_TEST00_FILESIZE
	string "Filesize"
	default 1G

config FSBENCHMARKS_TMPFS_TEST00_NUMJOBS
	int "Number of jobs"
	default 128

config FSBENCHMARKS_TMPFS_TEST00_MOUNTSIZE
	string "Mount size"
	default 512G

endmenu

config FSBENCHMARKS_TMPFS_TEST
	string
	default "test00" if FSBENCHMARKS_TMPFS_TEST00

endif
```

## workflows/linux/Kconfig.cel
```kconfig
if BOOTLINUX_TREE_CEL_LINUX

source "workflows/linux/Kconfig.refs-cel-linux"
source "workflows/linux/Kconfig.refs-cel-linux-gitref"

config BOOTLINUX_TREE_CEL_LINUX_CUSTOM_NAME
	string "Custom branch name"
	default "custom"
	depends on BOOTLINUX_TREE_CEL_LINUX_REF_CUSTOM
	help
	  Custom branch name to use for Chuck Lever's linux tree.

config BOOTLINUX_TREE_CEL_NAME
	string
	default "cel-linux"

config BOOTLINUX_TREE_CEL_URL
	string
	default "https://git.kernel.org/pub/scm/linux/kernel/git/cel/linux.git" if BOOTLINUX_TREE_CEL_LINUX

endif # BOOTLINUX_TREE_CEL_LINUX
```

## workflows/sysbench/Kconfig.native
```kconfig
choice
	prompt "What type of sysbench do you want to use?"
	default SYSBENCH_TYPE_POSTGRESQL_NATIVE

config SYSBENCH_TYPE_POSTGRESQL_NATIVE
	bool "Use PostgreSQL natively for Sysbench"
	output yaml
	select SYSBENCH_DB_TYPE_POSTGRESQL
	help
	  Enable this option to run sysbench using MySQL natively 
	  in the Guest OS.

endchoice

if SYSBENCH_TYPE_POSTGRESQL_NATIVE

choice
	prompt "Which PostgreSQL version to use?"
	default SYSBENCH_POSTGRESQL_VERSION_REL_17

config SYSBENCH_POSTGRESQL_VERSION_REL_17
	bool "PostgreSQL 17.m"
	output yaml
	help
	  Uses latest 17 release available (e.g. 17.0).

config SYSBENCH_POSTGRESQL_VERSION_REL_16
	bool "PostgreSQL 16.m"
	output yaml
	help
	  Uses latest 16 release available (e.g. 16.4).

config SYSBENCH_POSTGRESQL_VERSION_REL_15
	bool "PostgreSQL 15.m"
	output yaml
	help
	  Uses latest 15 release available (e.g. 15.8).

endchoice

config SYSBENCH_POSTGRESQL_REF_STRING
	string
	output yaml
	default "REL_17" if SYSBENCH_POSTGRESQL_VERSION_REL_17
	default "REL_16" if SYSBENCH_POSTGRESQL_VERSION_REL_16
	default "REL_15" if SYSBENCH_POSTGRESQL_VERSION_REL_15

config SYSBENCH_POSTGRESQL_LOGDIR
	string "PostgreSQL Log Directory"
	default "/var/log/postgresql"
	output yaml
	help
	  Where to place the database logs.

config SYSBENCH_POSTGRESQL_USER
	string "PostgreSQL User"
	default "postgres"
	output yaml
	help
	  PostgreSQL user running database daemon.

endif # SYSBENCH_TYPE_POSTGRESQL_NATIVE
```
